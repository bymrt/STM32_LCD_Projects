/*
 * Nokia5110.c
 *
 *  Created on: Mar 14, 2023
 *      Author: Ferhat
 */

#include "Nokia5110.h"

const unsigned char ASCII[][6] =
{
{ 0x00, 0x00, 0x00, 0x00, 0x00, 0x00 },// sp
{ 0x00, 0x00, 0x00, 0x2f, 0x00, 0x00 },// !
{ 0x00, 0x00, 0x07, 0x00, 0x07, 0x00 },// "
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{ 0x14, 0x14, 0x14, 0x14, 0x14, 0x14 }// horiz lines
};




bool Nokia5110_Init(void)
{
	Nokia5110_Reset();
	//ekranı veri data alımı icin hazir hale getirir
	Nokia5110_Write(0x21, 0);
	Nokia5110_Write(0xC0, 0);
	Nokia5110_Write(0x07, 0);
	Nokia5110_Write(0x13, 0);
	Nokia5110_Write(0x20, 0);
	Nokia5110_Write(0x0C, 0);
	LCD_Clear();
	return true;
}


void LCD_Clear(void) {
  uint8_t satir; // satırlar
  uint8_t sutun; // sutunlar
  LCD_Set_Postion(0,0);
  for(satir=0;satir<6;satir++)
  {
    for(sutun=0;sutun<84;sutun++)
    {
    	Nokia5110_BufferWrite(0x00); //tum pikselleri resetler
    }
  }
}


void Nokia5110_Reset(void)
{
	HAL_GPIO_WritePin(GPIOD, GPIO_PIN_8, GPIO_PIN_RESET); // Reset pin is low
	HAL_Delay(100);
	HAL_GPIO_WritePin(GPIOD, GPIO_PIN_8, GPIO_PIN_SET); // Reset pin is high

}




bool Nokia5110_Write(uint8_t data, uint8_t mode)
{
	HAL_GPIO_WritePin(GPIOD, GPIO_PIN_9, GPIO_PIN_RESET); // CE pin is low

	if(mode == 0)
		HAL_GPIO_WritePin(GPIOD, GPIO_PIN_10, GPIO_PIN_RESET);  // DC pin is low for sending data

	else if (mode == 1)
		HAL_GPIO_WritePin(GPIOD, GPIO_PIN_10, GPIO_PIN_SET);  // DC pin is high for command send

	else
	{
		HAL_GPIO_WritePin(GPIOD, GPIO_PIN_9, GPIO_PIN_SET); // CE pin is High
		return false;
	}

	HAL_SPI_Transmit_DMA(&hspi2, &data, 1); // veriyi spi aracılıgı ile gonderir
	return true;
}

void Nokia5110_BufferWrite(uint8_t data)
{
	//pikselleri ekrana yazar
	HAL_GPIO_WritePin(GPIOD, GPIO_PIN_9, GPIO_PIN_RESET); // CE pin is low
	HAL_GPIO_WritePin(GPIOD, GPIO_PIN_10, GPIO_PIN_SET);  // DC pin is high for command send
	HAL_SPI_Transmit_DMA(&hspi2, &data, 0x01);

}


void LCD_Write_Char(uint8_t ch) {
  uint8_t line;
  ch -= 32;
  for (line=0; line<6; line++){
	  Nokia5110_BufferWrite(ASCII[ch][line]);
  }
}


void LCD_Write_String(char *str,uint8_t PosX, uint8_t PosY)
{
	LCD_Set_Postion(PosX, PosY);
  while(* str) {
    LCD_Write_Char(* str);
    str ++;
  }
}



void LCD_Set_Postion(uint8_t posX, uint8_t posY)
{
	//verilen kordinatlara gider
	LCD_Write_Command(0x40 | posY);
	LCD_Write_Command(0x80 | posX);
}


void LCD_Write_Command(uint8_t cmd)
{
	//verilen kordinatlara gider
	HAL_GPIO_WritePin(GPIOD, GPIO_PIN_9, GPIO_PIN_RESET);
	HAL_GPIO_WritePin(GPIOD, GPIO_PIN_10, GPIO_PIN_RESET);
	HAL_SPI_Transmit_DMA(&hspi2, &cmd, 0x01);

	HAL_GPIO_WritePin(GPIOD, GPIO_PIN_9, GPIO_PIN_SET);
	HAL_GPIO_WritePin(GPIOD, GPIO_PIN_10, GPIO_PIN_SET);

}






